## linux-2.6.37-tn_mupu_dr/drivers/chstime_hr_n/Kconfig
```kconfig
menuconfig KERNEL_TIMERS
       bool "TIMERS support"

if KERNEL_TIMERS

config MULTI_HR_TIMER_DRIVER
	tristate "Multi HR timer" 
        default y
        help
		This is driver for kernel multi HR timer. The driver of the I/O.
		Say Y here if you have a MULTI_HR_TIMER_DRIVER in your system.

		To compile this driver as a module, choose M here: the
		module will be called psmouse.

endif
```

## linux-2.6.37-tn_mupu_dr/drivers/pvv/Kconfig
```kconfig
menuconfig UPUM6
       bool "UPUM6 PVV support"

if UPUM6

config UPUPVV
        bool "Platform  PVV support"
        default y
        help
	        Include platform dependences for UPUM6 PVV


config PVV_DRIVER
	tristate "Driver PVV" 
        default y
        help
		This is driver for UPU_M6. The driver of the I/O.
		Say Y here if you have a PVV_DRIVER in your system.

		To compile this driver as a module, choose M here: the
		module will be called psmouse.

config PVV1_DRIVER
        tristate "Driver PVV1"
        default y
        help
		This is driver for UPU_M6. The driver of the I/O.
        	Say Y here if you have a PVV1_DRIVER in your system.

	        To compile this driver as a module, choose M here: the
        	module will be called psmouse.

config PVV2_DRIVER
        tristate "Driver PVV2"
        default y
        help
		This is driver for UPU_M6. The driver of the I/O.
        	Say Y here if you have a PVV1_DRIVER in your system.

	        To compile this driver as a module, choose M here: the
        	module will be called psmouse.

endif
```

## linux-2.6.37-tn_mupu_dr/drivers/pvv3/Kconfig
```kconfig
menuconfig UPUM6_DPU_TEST
       bool "UPUM6 PVV3 DPU_TEST support"

if UPUM6_DPU_TEST

config UPUPVV
        bool "Platform  PVV support"
        default y
        help
	        Include platform dependences for UPUM6 PVV

config PVV3_DRIVER
        tristate "Driver PVV3"
        default m
        help
                This is driver for UPU_M6. The driver of the I/O.
                Say Y here if you have a PVV3_DRIVER (DPU only) in your system.

                To compile this driver as a module, choose M here: the
                module will be called psmouse.
endif
```

## linux-2.6.37-tn_mupu_dr/drivers/pvv4/Kconfig
```kconfig
menuconfig UPUM6_DPU_RM
       bool "UPUM6 PVV4 DPU_RM support"

if UPUM6_DPU_RM

config UPUPVV
        bool "Platform  PVV support"
        default y
        help
	        Include platform dependences for UPUM6 PVV

config PVV4_DRIVER
        tristate "Driver PVV4"
        default m
        help
                This is driver for UPU_M6. The driver of the I/O.
                Say Y here if you have a PVV3_DRIVER (DPU and RM) in your system.

                To compile this driver as a module, choose M here: the
                module will be called psmouse.
endif
```

## linux-2.6.37-tn_mupu_dr/drivers/pvv5/Kconfig
```kconfig
menuconfig UPUM7_485_TEST
       bool "UPUM7 PVV5 DPU_485_TEST support"

if UPUM7_485_TEST

config UPUPVV
        bool "Platform  PVV support"
        default y
        help
	        Include platform dependences for UPUM7 PVV

config PVV5_DRIVER
        tristate "Driver PVV5"
        default m
        help
                This is driver for UPU_M7. The driver of the I/O.
                Say Y here if you have a PVV5_DRIVER (DPU only) in your system.

                To compile this driver as a module, choose M here: the
                module will be called psmouse.
endif
```

## linux-2.6.37-tn_mupu_dr/drivers/tty/serial/Kconfig
```kconfig
#
# Serial device configuration
#

config SERIAL_SC16IS7XX
	bool "Serial device SC16IS7XX"

if SERIAL_SC16IS7XX

config SERIAL_SC16IS7XX_I2C_MOD
#	bool "SC16IS7xx modyle for I2C interface"
	tristate "SC16IS7xx serial support on i2c"
	default m
#	#depends on SERIAL_SC16IS7XX
	depends on I2C
#	#select SERIAL_SC16IS7XX_CORE if SERIAL_SC16IS7XX
##	select REGMAP_I2C if I2C
#
	help:
	  Enable SC16IS7xx driver on I2C bus (module),
	  If required say y, and say n to i2c if not required,
	  Enabled by default to support oldconfig.
#	#You must select at least one bus for the driver to be built.

endif

config TINY_SERIAL
        tristate "TINY SERIAL"
        default m
        help: 
	  Enable test driver tiny_serial.
          If required say y, and say n to i2c if not required,
          Enabled by default to support oldconfig.


config TINY_TTY
        tristate "TINY TTY"
        default m
        help:
          Enable test driver tiny_tty.
          If required say y, and say n to i2c if not required,
          Enabled by default to support oldconfig.


#endmenu
```

## linux-4.9.6/drivers/chstime_hr/Kconfig
```kconfig
menuconfig KSDSERV2
       bool "KSD SERVER support timer hr"

if KSDSERV2

config KSD_TIMER_DRIVER_HR
	tristate "Driver hr timer for KSD SERVER" 
        default y
        help
		This is driver for KSD HR TIMER for SERVER (default 350mc). 
		Say Y here if you have a KSD HR TIMER for SERVER in your system.

		To compile this driver as a module, choose M here: the
		module will be called psmouse.

endif
```

## linux-4.9.6/drivers/multi_event/Kconfig
```kconfig
menuconfig KSDSERV4
       bool "KSD SERVER support event for 'n' devices"

if KSDSERV4

config KSD_MULTI_EVENT
	tristate "Driver event for KSD SERVER" 
        default y
        help
		This is driver for KSD MULTI EVENT for SERVER (two device only) . 
		Say Y here if you have a KSD MULTI EVENT for SERVER in your system.

		To compile this driver as a module, choose M here: the
		module will be called psmouse.

endif
```

## linux-4.9.6_Minsk/drivers/chstime/Kconfig
```kconfig
menuconfig KSDSERV1
       bool "KSD SERVER support timer"

if KSDSERV1

config KSD_TIMER_DRIVER
	tristate "Driver timer for KSD SERVER" 
        default y
        help
		This is driver for KSD TIMER for SERVER (default 3c). 
		Say Y here if you have a KSD TIMER for  SERVER in your system.

		To compile this driver as a module, choose M here: the
		module will be called psmouse.

endif
```

## linux-4.9.6_minsk/drivers/chstime_hr_n/Kconfig
```kconfig
menuconfig KSDSERV3
       bool "KSD SERVER support multi timer hr for 'n' devices"

if KSDSERV3

config KSD_TIMER_DRIVER_HR_MULTI
	tristate "Driver hr multi timer for KSD SERVER" 
        default y
        help
		This is driver for KSD HR MULTI TIMER for SERVER (default 350mc). 
		Say Y here if you have a KSD HR MULTI TIMER for SERVER in your system.

		To compile this driver as a module, choose M here: the
		module will be called psmouse.

endif
```
